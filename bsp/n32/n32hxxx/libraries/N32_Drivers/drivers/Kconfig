## bsp/n32/n32hxxx/n32h487zgl7-evb/board/Kconfig
```kconfig
menu "Hardware Drivers Config"

menu "Onboard Peripheral Drivers"

endmenu

menu "On-chip Peripheral Drivers"

    config BSP_USING_GPIO
        bool "Enable GPIO"
        select RT_USING_PIN
        default y

    menuconfig BSP_USING_UART
        bool "Enable UART"
        default y
        select RT_USING_SERIAL
        if BSP_USING_UART
            config BSP_USING_UART1
                bool "Enable UART1"
                default y

            config BSP_UART1_RX_USING_DMA
                bool "Enable UART1 RX DMA"
                depends on BSP_USING_UART1 && RT_SERIAL_USING_DMA
                default n

            config BSP_UART1_TX_USING_DMA
                bool "Enable UART1 TX DMA"
                depends on BSP_USING_UART1 && RT_SERIAL_USING_DMA
                default n

            config BSP_USING_UART2
                bool "Enable UART2"
                default n

            config BSP_UART2_RX_USING_DMA
                bool "Enable UART2 RX DMA"
                depends on BSP_USING_UART2 && RT_SERIAL_USING_DMA
                default n

            config BSP_UART2_TX_USING_DMA
                bool "Enable UART2 TX DMA"
                depends on BSP_USING_UART2 && RT_SERIAL_USING_DMA
                default n

            config BSP_USING_UART3
                bool "Enable UART3"
                default n

            config BSP_UART3_RX_USING_DMA
                bool "Enable UART3 RX DMA"
                depends on BSP_USING_UART3 && RT_SERIAL_USING_DMA
                default n

            config BSP_UART3_TX_USING_DMA
                bool "Enable UART3 TX DMA"
                depends on BSP_USING_UART3 && RT_SERIAL_USING_DMA
                default n

            config BSP_USING_UART4
                bool "Enable UART4"
                default n

            config BSP_UART4_RX_USING_DMA
                bool "Enable UART4 RX DMA"
                depends on BSP_USING_UART4 && RT_SERIAL_USING_DMA
                default n

            config BSP_UART4_TX_USING_DMA
                bool "Enable UART4 TX DMA"
                depends on BSP_USING_UART4 && RT_SERIAL_USING_DMA
                default n

            config BSP_USING_UART5
                bool "Enable UART5"
                default n

            config BSP_UART5_RX_USING_DMA
                bool "Enable UART5 RX DMA"
                depends on BSP_USING_UART5 && RT_SERIAL_USING_DMA
                default n

            config BSP_UART5_TX_USING_DMA
                bool "Enable UART5 TX DMA"
                depends on BSP_USING_UART5 && RT_SERIAL_USING_DMA
                default n

            config BSP_USING_UART6
                bool "Enable UART6"
                default n

            config BSP_UART6_RX_USING_DMA
                bool "Enable UART6 RX DMA"
                depends on BSP_USING_UART6 && RT_SERIAL_USING_DMA
                default n

            config BSP_UART6_TX_USING_DMA
                bool "Enable UART6 TX DMA"
                depends on BSP_USING_UART6 && RT_SERIAL_USING_DMA
                default n

            config BSP_USING_UART7
                bool "Enable UART7"
                default n

            config BSP_UART7_RX_USING_DMA
                bool "Enable UART7 RX DMA"
                depends on BSP_USING_UART7 && RT_SERIAL_USING_DMA
                default n

            config BSP_UART7_TX_USING_DMA
                bool "Enable UART7 TX DMA"
                depends on BSP_USING_UART7 && RT_SERIAL_USING_DMA
                default n

            config BSP_USING_UART8
                bool "Enable UART8"
                default n

            config BSP_UART8_RX_USING_DMA
                bool "Enable UART8 RX DMA"
                depends on BSP_USING_UART8 && RT_SERIAL_USING_DMA
                default n

            config BSP_UART8_TX_USING_DMA
                bool "Enable UART8 TX DMA"
                depends on BSP_USING_UART8 && RT_SERIAL_USING_DMA
                default n

        endif

    config BSP_USING_ON_CHIP_FLASH
        bool "Enable on-chip FLASH"
        default n

    menuconfig BSP_USING_ONCHIP_RTC
    bool "Enable RTC"
    select RT_USING_RTC
    default n
    if BSP_USING_ONCHIP_RTC
        choice BSP_RTC_LS_SEL
            prompt "Select clock source"
            default BSP_RTC_USING_LSE

            config BSP_RTC_USING_LSE
                bool "RTC USING LSE"

            config BSP_RTC_USING_LSI
                bool "RTC USING LSI"
        endchoice
    endif

    config BSP_USING_WDT
        bool "Enable Watchdog Timer"
        select RT_USING_WDT
        default n

    menuconfig BSP_USING_FDCAN
        bool "Enable FDCAN (CAN FD)"
        default n
        select RT_USING_CAN
        select RT_CAN_USING_CANFD
        select RT_CAN_USING_HDR
        if BSP_USING_FDCAN
            config BSP_FDCAN_MSG_RAM_WORDS
                int "Shared Message RAM size (32-bit words)"
                range 1 4480
                default 768
                help
                    One continuous Message RAM array shared by FDCAN1/2/3.
                    Enabled instances are packed in instance order using
                    each instance's configured resource requirement.

            config BSP_USING_FDCAN1
                bool "Enable FDCAN1"
                default n
                if BSP_USING_FDCAN1
                    menu "FDCAN1 resource configuration"
                        config BSP_FDCAN1_USING_TDC
                            bool "Enable transmitter delay compensation"
                            default n

                        if BSP_FDCAN1_USING_TDC
                            config BSP_FDCAN1_TDC_OFFSET
                                int "TDC offset"
                                range 0 127
                                default 0

                            config BSP_FDCAN1_TDC_FILTER
                                int "TDC filter window"
                                range 0 127
                                default 0
                        endif

                        config BSP_FDCAN1_STD_FILTER_SIZE
                            int "Standard ID filter elements"
                            range 0 128
                            default 2

                        config BSP_FDCAN1_EXT_FILTER_SIZE
                            int "Extended ID filter elements"
                            range 0 64
                            default 2

                        config BSP_FDCAN1_RX_FIFO0_SIZE
                            int "RX FIFO0 elements"
                            range 1 64
                            default 8

                        config BSP_FDCAN1_RX_FIFO0_DATA_BYTES
                            int "RX FIFO0 data bytes per element"
                            range 8 64
                            default 64
                            help
                                Valid values: 8, 12, 16, 20, 24, 32, 48 or 64.

                        config BSP_FDCAN1_RX_FIFO1_SIZE
                            int "RX FIFO1 elements"
                            range 0 64
                            default 0

                        config BSP_FDCAN1_RX_FIFO1_DATA_BYTES
                            int "RX FIFO1 data bytes per element"
                            range 8 64
                            default 64
                            help
                                Valid values: 8, 12, 16, 20, 24, 32, 48 or 64.

                        config BSP_FDCAN1_RX_BUFFER_SIZE
                            int "Dedicated RX buffer elements"
                            range 0 64
                            default 0

                        config BSP_FDCAN1_RX_BUFFER_DATA_BYTES
                            int "Dedicated RX buffer data bytes per element"
                            range 8 64
                            default 64
                            help
                                Valid values: 8, 12, 16, 20, 24, 32, 48 or 64.

                        config BSP_FDCAN1_TX_EVENT_FIFO_SIZE
                            int "TX event FIFO elements"
                            range 0 32
                            default 0

                        config BSP_FDCAN1_TX_BUFFER_SIZE
                            int "Dedicated TX buffer elements"
                            range 1 32
                            default 3

                        config BSP_FDCAN1_TX_BUFFER_DATA_BYTES
                            int "TX buffer/FIFO data bytes per element"
                            range 8 64
                            default 64
                            help
                                Valid values: 8, 12, 16, 20, 24, 32, 48 or 64.

                        config BSP_FDCAN1_TX_QUEUE_MODE
                            bool "Use TX Queue mode (otherwise FIFO mode)"
                            default n

                        config BSP_FDCAN1_TX_FIFO_QUEUE_SIZE
                            int "TX FIFO/Queue elements"
                            range 0 31
                            default 0
                    endmenu
                endif

            config BSP_USING_FDCAN2
                bool "Enable FDCAN2"
                default n
                if BSP_USING_FDCAN2
                    menu "FDCAN2 resource configuration"
                        config BSP_FDCAN2_USING_TDC
                            bool "Enable transmitter delay compensation"
                            default n

                        if BSP_FDCAN2_USING_TDC
                            config BSP_FDCAN2_TDC_OFFSET
                                int "TDC offset"
                                range 0 127
                                default 0

                            config BSP_FDCAN2_TDC_FILTER
                                int "TDC filter window"
                                range 0 127
                                default 0
                        endif

                        config BSP_FDCAN2_STD_FILTER_SIZE
                            int "Standard ID filter elements"
                            range 0 128
                            default 2

                        config BSP_FDCAN2_EXT_FILTER_SIZE
                            int "Extended ID filter elements"
                            range 0 64
                            default 2

                        config BSP_FDCAN2_RX_FIFO0_SIZE
                            int "RX FIFO0 elements"
                            range 1 64
                            default 8

                        config BSP_FDCAN2_RX_FIFO0_DATA_BYTES
                            int "RX FIFO0 data bytes per element"
                            range 8 64
                            default 64
                            help
                                Valid values: 8, 12, 16, 20, 24, 32, 48 or 64.

                        config BSP_FDCAN2_RX_FIFO1_SIZE
                            int "RX FIFO1 elements"
                            range 0 64
                            default 0

                        config BSP_FDCAN2_RX_FIFO1_DATA_BYTES
                            int "RX FIFO1 data bytes per element"
                            range 8 64
                            default 64
                            help
                                Valid values: 8, 12, 16, 20, 24, 32, 48 or 64.

                        config BSP_FDCAN2_RX_BUFFER_SIZE
                            int "Dedicated RX buffer elements"
                            range 0 64
                            default 0

                        config BSP_FDCAN2_RX_BUFFER_DATA_BYTES
                            int "Dedicated RX buffer data bytes per element"
                            range 8 64
                            default 64
                            help
                                Valid values: 8, 12, 16, 20, 24, 32, 48 or 64.

                        config BSP_FDCAN2_TX_EVENT_FIFO_SIZE
                            int "TX event FIFO elements"
                            range 0 32
                            default 0

                        config BSP_FDCAN2_TX_BUFFER_SIZE
                            int "Dedicated TX buffer elements"
                            range 1 32
                            default 3

                        config BSP_FDCAN2_TX_BUFFER_DATA_BYTES
                            int "TX buffer/FIFO data bytes per element"
                            range 8 64
                            default 64
                            help
                                Valid values: 8, 12, 16, 20, 24, 32, 48 or 64.

                        config BSP_FDCAN2_TX_QUEUE_MODE
                            bool "Use TX Queue mode (otherwise FIFO mode)"
                            default n

                        config BSP_FDCAN2_TX_FIFO_QUEUE_SIZE
                            int "TX FIFO/Queue elements"
                            range 0 31
                            default 0
                    endmenu
                endif

            config BSP_USING_FDCAN3
                bool "Enable FDCAN3"
                default n
                if BSP_USING_FDCAN3
                    menu "FDCAN3 resource configuration"
                        config BSP_FDCAN3_USING_TDC
                            bool "Enable transmitter delay compensation"
                            default n

                        if BSP_FDCAN3_USING_TDC
                            config BSP_FDCAN3_TDC_OFFSET
                                int "TDC offset"
                                range 0 127
                                default 0

                            config BSP_FDCAN3_TDC_FILTER
                                int "TDC filter window"
                                range 0 127
                                default 0
                        endif

                        config BSP_FDCAN3_STD_FILTER_SIZE
                            int "Standard ID filter elements"
                            range 0 128
                            default 2

                        config BSP_FDCAN3_EXT_FILTER_SIZE
                            int "Extended ID filter elements"
                            range 0 64
                            default 2

                        config BSP_FDCAN3_RX_FIFO0_SIZE
                            int "RX FIFO0 elements"
                            range 1 64
                            default 8

                        config BSP_FDCAN3_RX_FIFO0_DATA_BYTES
                            int "RX FIFO0 data bytes per element"
                            range 8 64
                            default 64
                            help
                                Valid values: 8, 12, 16, 20, 24, 32, 48 or 64.

                        config BSP_FDCAN3_RX_FIFO1_SIZE
                            int "RX FIFO1 elements"
                            range 0 64
                            default 0

                        config BSP_FDCAN3_RX_FIFO1_DATA_BYTES
                            int "RX FIFO1 data bytes per element"
                            range 8 64
                            default 64
                            help
                                Valid values: 8, 12, 16, 20, 24, 32, 48 or 64.

                        config BSP_FDCAN3_RX_BUFFER_SIZE
                            int "Dedicated RX buffer elements"
                            range 0 64
                            default 0

                        config BSP_FDCAN3_RX_BUFFER_DATA_BYTES
                            int "Dedicated RX buffer data bytes per element"
                            range 8 64
                            default 64
                            help
                                Valid values: 8, 12, 16, 20, 24, 32, 48 or 64.

                        config BSP_FDCAN3_TX_EVENT_FIFO_SIZE
                            int "TX event FIFO elements"
                            range 0 32
                            default 0

                        config BSP_FDCAN3_TX_BUFFER_SIZE
                            int "Dedicated TX buffer elements"
                            range 1 32
                            default 3

                        config BSP_FDCAN3_TX_BUFFER_DATA_BYTES
                            int "TX buffer/FIFO data bytes per element"
                            range 8 64
                            default 64
                            help
                                Valid values: 8, 12, 16, 20, 24, 32, 48 or 64.

                        config BSP_FDCAN3_TX_QUEUE_MODE
                            bool "Use TX Queue mode (otherwise FIFO mode)"
                            default n

                        config BSP_FDCAN3_TX_FIFO_QUEUE_SIZE
                            int "TX FIFO/Queue elements"
                            range 0 31
                            default 0
                    endmenu
                endif
        endif

    config BSP_USING_ON_CHIP_FLASH
        bool "Enable on-chip FLASH"
        default n

    menuconfig BSP_USING_ONCHIP_RTC
    bool "Enable RTC"
    select RT_USING_RTC
    default n
    if BSP_USING_ONCHIP_RTC
        choice BSP_RTC_LS_SEL
            prompt "Select clock source"
            default BSP_RTC_USING_LSE

            config BSP_RTC_USING_LSE
                bool "RTC USING LSE"

            config BSP_RTC_USING_LSI
                bool "RTC USING LSI"
        endchoice
    endif

    menuconfig BSP_USING_FDCAN
        bool "Enable FDCAN (CAN FD)"
        default n
        select RT_USING_CAN
        select RT_CAN_USING_CANFD
        select RT_CAN_USING_HDR
        if BSP_USING_FDCAN
            config BSP_FDCAN_MSG_RAM_WORDS
                int "Shared Message RAM size (32-bit words)"
                range 1 4480
                default 768
                help
                    One continuous Message RAM array shared by FDCAN1/2/3.
                    Enabled instances are packed in instance order using
                    each instance's configured resource requirement.

            config BSP_USING_FDCAN1
                bool "Enable FDCAN1"
                default n
                if BSP_USING_FDCAN1
                    menu "FDCAN1 resource configuration"
                        config BSP_FDCAN1_USING_TDC
                            bool "Enable transmitter delay compensation"
                            default n

                        if BSP_FDCAN1_USING_TDC
                            config BSP_FDCAN1_TDC_OFFSET
                                int "TDC offset"
                                range 0 127
                                default 0

                            config BSP_FDCAN1_TDC_FILTER
                                int "TDC filter window"
                                range 0 127
                                default 0
                        endif

                        config BSP_FDCAN1_STD_FILTER_SIZE
                            int "Standard ID filter elements"
                            range 0 128
                            default 2

                        config BSP_FDCAN1_EXT_FILTER_SIZE
                            int "Extended ID filter elements"
                            range 0 64
                            default 2

                        config BSP_FDCAN1_RX_FIFO0_SIZE
                            int "RX FIFO0 elements"
                            range 1 64
                            default 8

                        config BSP_FDCAN1_RX_FIFO0_DATA_BYTES
                            int "RX FIFO0 data bytes per element"
                            range 8 64
                            default 64
                            help
                                Valid values: 8, 12, 16, 20, 24, 32, 48 or 64.

                        config BSP_FDCAN1_RX_FIFO1_SIZE
                            int "RX FIFO1 elements"
                            range 0 64
                            default 0

                        config BSP_FDCAN1_RX_FIFO1_DATA_BYTES
                            int "RX FIFO1 data bytes per element"
                            range 8 64
                            default 64
                            help
                                Valid values: 8, 12, 16, 20, 24, 32, 48 or 64.

                        config BSP_FDCAN1_RX_BUFFER_SIZE
                            int "Dedicated RX buffer elements"
                            range 0 64
                            default 0

                        config BSP_FDCAN1_RX_BUFFER_DATA_BYTES
                            int "Dedicated RX buffer data bytes per element"
                            range 8 64
                            default 64
                            help
                                Valid values: 8, 12, 16, 20, 24, 32, 48 or 64.

                        config BSP_FDCAN1_TX_EVENT_FIFO_SIZE
                            int "TX event FIFO elements"
                            range 0 32
                            default 0

                        config BSP_FDCAN1_TX_BUFFER_SIZE
                            int "Dedicated TX buffer elements"
                            range 1 32
                            default 3

                        config BSP_FDCAN1_TX_BUFFER_DATA_BYTES
                            int "TX buffer/FIFO data bytes per element"
                            range 8 64
                            default 64
                            help
                                Valid values: 8, 12, 16, 20, 24, 32, 48 or 64.

                        config BSP_FDCAN1_TX_QUEUE_MODE
                            bool "Use TX Queue mode (otherwise FIFO mode)"
                            default n

                        config BSP_FDCAN1_TX_FIFO_QUEUE_SIZE
                            int "TX FIFO/Queue elements"
                            range 0 31
                            default 0
                    endmenu
                endif

            config BSP_USING_FDCAN2
                bool "Enable FDCAN2"
                default n
                if BSP_USING_FDCAN2
                    menu "FDCAN2 resource configuration"
                        config BSP_FDCAN2_USING_TDC
                            bool "Enable transmitter delay compensation"
                            default n

                        if BSP_FDCAN2_USING_TDC
                            config BSP_FDCAN2_TDC_OFFSET
                                int "TDC offset"
                                range 0 127
                                default 0

                            config BSP_FDCAN2_TDC_FILTER
                                int "TDC filter window"
                                range 0 127
                                default 0
                        endif

                        config BSP_FDCAN2_STD_FILTER_SIZE
                            int "Standard ID filter elements"
                            range 0 128
                            default 2

                        config BSP_FDCAN2_EXT_FILTER_SIZE
                            int "Extended ID filter elements"
                            range 0 64
                            default 2

                        config BSP_FDCAN2_RX_FIFO0_SIZE
                            int "RX FIFO0 elements"
                            range 1 64
                            default 8

                        config BSP_FDCAN2_RX_FIFO0_DATA_BYTES
                            int "RX FIFO0 data bytes per element"
                            range 8 64
                            default 64
                            help
                                Valid values: 8, 12, 16, 20, 24, 32, 48 or 64.

                        config BSP_FDCAN2_RX_FIFO1_SIZE
                            int "RX FIFO1 elements"
                            range 0 64
                            default 0

                        config BSP_FDCAN2_RX_FIFO1_DATA_BYTES
                            int "RX FIFO1 data bytes per element"
                            range 8 64
                            default 64
                            help
                                Valid values: 8, 12, 16, 20, 24, 32, 48 or 64.

                        config BSP_FDCAN2_RX_BUFFER_SIZE
                            int "Dedicated RX buffer elements"
                            range 0 64
                            default 0

                        config BSP_FDCAN2_RX_BUFFER_DATA_BYTES
                            int "Dedicated RX buffer data bytes per element"
                            range 8 64
                            default 64
                            help
                                Valid values: 8, 12, 16, 20, 24, 32, 48 or 64.

                        config BSP_FDCAN2_TX_EVENT_FIFO_SIZE
                            int "TX event FIFO elements"
                            range 0 32
                            default 0

                        config BSP_FDCAN2_TX_BUFFER_SIZE
                            int "Dedicated TX buffer elements"
                            range 1 32
                            default 3

                        config BSP_FDCAN2_TX_BUFFER_DATA_BYTES
                            int "TX buffer/FIFO data bytes per element"
                            range 8 64
                            default 64
                            help
                                Valid values: 8, 12, 16, 20, 24, 32, 48 or 64.

                        config BSP_FDCAN2_TX_QUEUE_MODE
                            bool "Use TX Queue mode (otherwise FIFO mode)"
                            default n

                        config BSP_FDCAN2_TX_FIFO_QUEUE_SIZE
                            int "TX FIFO/Queue elements"
                            range 0 31
                            default 0
                    endmenu
                endif

            config BSP_USING_FDCAN3
                bool "Enable FDCAN3"
                default n
                if BSP_USING_FDCAN3
                    menu "FDCAN3 resource configuration"
                        config BSP_FDCAN3_USING_TDC
                            bool "Enable transmitter delay compensation"
                            default n

                        if BSP_FDCAN3_USING_TDC
                            config BSP_FDCAN3_TDC_OFFSET
                                int "TDC offset"
                                range 0 127
                                default 0

                            config BSP_FDCAN3_TDC_FILTER
                                int "TDC filter window"
                                range 0 127
                                default 0
                        endif

                        config BSP_FDCAN3_STD_FILTER_SIZE
                            int "Standard ID filter elements"
                            range 0 128
                            default 2

                        config BSP_FDCAN3_EXT_FILTER_SIZE
                            int "Extended ID filter elements"
                            range 0 64
                            default 2

                        config BSP_FDCAN3_RX_FIFO0_SIZE
                            int "RX FIFO0 elements"
                            range 1 64
                            default 8

                        config BSP_FDCAN3_RX_FIFO0_DATA_BYTES
                            int "RX FIFO0 data bytes per element"
                            range 8 64
                            default 64
                            help
                                Valid values: 8, 12, 16, 20, 24, 32, 48 or 64.

                        config BSP_FDCAN3_RX_FIFO1_SIZE
                            int "RX FIFO1 elements"
                            range 0 64
                            default 0

                        config BSP_FDCAN3_RX_FIFO1_DATA_BYTES
                            int "RX FIFO1 data bytes per element"
                            range 8 64
                            default 64
                            help
                                Valid values: 8, 12, 16, 20, 24, 32, 48 or 64.

                        config BSP_FDCAN3_RX_BUFFER_SIZE
                            int "Dedicated RX buffer elements"
                            range 0 64
                            default 0

                        config BSP_FDCAN3_RX_BUFFER_DATA_BYTES
                            int "Dedicated RX buffer data bytes per element"
                            range 8 64
                            default 64
                            help
                                Valid values: 8, 12, 16, 20, 24, 32, 48 or 64.

                        config BSP_FDCAN3_TX_EVENT_FIFO_SIZE
                            int "TX event FIFO elements"
                            range 0 32
                            default 0

                        config BSP_FDCAN3_TX_BUFFER_SIZE
                            int "Dedicated TX buffer elements"
                            range 1 32
                            default 3

                        config BSP_FDCAN3_TX_BUFFER_DATA_BYTES
                            int "TX buffer/FIFO data bytes per element"
                            range 8 64
                            default 64
                            help
                                Valid values: 8, 12, 16, 20, 24, 32, 48 or 64.

                        config BSP_FDCAN3_TX_QUEUE_MODE
                            bool "Use TX Queue mode (otherwise FIFO mode)"
                            default n

                        config BSP_FDCAN3_TX_FIFO_QUEUE_SIZE
                            int "TX FIFO/Queue elements"
                            range 0 31
                            default 0
                    endmenu
                endif
        endif

    menuconfig BSP_USING_NAND
        bool "Enable Nand"
        default n
        select RT_USING_MTD_NAND
        if BSP_USING_NAND
            choice BSP_NAND_BANK_SEL
                prompt "Select Bank"
                default BSP_USING_NAND_BANK3

                config BSP_USING_NAND_BANK2
                    bool "USING FEMC NAND BANK2"

                config BSP_USING_NAND_BANK3
                    bool "USING FEMC NAND BANK3"
            endchoice

            choice BSP_NAND_BUS_WIDTH_SEL
                prompt "Select Nand Bus Width"
                default BSP_USING_NAND_BUS_WIDTH_8B

                config BSP_USING_NAND_BUS_WIDTH_8B
                    bool "USING FEMC NAND BUS WIDTH 8BIT"

                config BSP_USING_NAND_BUS_WIDTH_16B
                    bool "USING FEMC NAND BUS WIDTH 16BIT"
            endchoice

            config BSP_NAND_PAGE_SIZE
                int "Page Size (bytes)"
                default 2048
                help
                    NAND flash page size in bytes, typically 2048 or 4096.

            config BSP_NAND_OOB_SIZE
                int "OOB (Spare Area) Size (bytes)"
                default 64
                help
                    NAND flash spare area size per page, typically 64 or 128.

            config BSP_NAND_PAGES_PER_BLOCK
                int "Pages Per Block"
                default 64
                help
                    Number of pages per erase block, typically 64 or 128.

            config BSP_NAND_BLOCK_COUNT
                int "Total Block Count"
                default 1024
                help
                    Total number of blocks in the NAND flash chip.

            config BSP_NAND_PLANE_NUM
                int "Plane Number"
                default 1
                help
                    Number of planes in the NAND flash chip, typically 1 or 2.
        endif

    source "$BSP_DIR/../libraries/N32_Drivers/drivers/Kconfig"

endmenu

menu "Board extended module Drivers"

endmenu

endmenu
```
