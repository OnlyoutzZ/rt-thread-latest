## bsp/n32/n32hxxx/n32h497zgl7-evb/board/Kconfig
```kconfig
menu "Hardware Drivers Config"

menu "Onboard Peripheral Drivers"

    menuconfig BSP_USING_SDRAM
        bool "Enable SDRAM"
        default n
        if BSP_USING_SDRAM
            choice BSP_SDRAM_BANK_SEL
                prompt "Select SDRAM Bank"
                default BSP_SDRAM_BANK1

                config BSP_SDRAM_BANK1
                    bool "Select SDRAM Bank1"

                config BSP_SDRAM_BANK2
                    bool "Select SDRAM Bank2"
            endchoice

            choice BSP_SDRAM_DATA_WIDTH_SEL
                prompt "Select SDRAM Data Width"
                default BSP_SDRAM_DATA_WIDTH_32

                config BSP_SDRAM_DATA_WIDTH_8
                    bool "SDRAM Data Width 8-bits"

                config BSP_SDRAM_DATA_WIDTH_16
                    bool "SDRAM Data Width 16-bits"

                config BSP_SDRAM_DATA_WIDTH_32
                    bool "SDRAM Data Width 32-bits"
            endchoice

            choice BSP_SDRAM_COLUMN_BITS_SEL
                prompt "Select SDRAM Column Bits"
                default BSP_SDRAM_COLUMN_BIT_9

                config BSP_SDRAM_COLUMN_BIT_8
                    bool "SDRAM SDRAM Column Bits 8-bits"

                config BSP_SDRAM_COLUMN_BIT_9
                    bool "SDRAM SDRAM Column Bits 9-bits"

                config BSP_SDRAM_COLUMN_BIT_10
                    bool "SDRAM SDRAM Column Bits 10-bits"

                config BSP_SDRAM_COLUMN_BIT_11
                    bool "SDRAM SDRAM Column Bits 11-bits"
            endchoice

            choice BSP_SDRAM_ROW_BITS_SEL
                prompt "Select SDRAM Row Bits"
                default BSP_SDRAM_ROW_BIT_12

                config BSP_SDRAM_ROW_BIT_11
                    bool "SDRAM SDRAM Row Bits 11-bits"

                config BSP_SDRAM_ROW_BIT_12
                    bool "SDRAM SDRAM Row Bits 12-bits"

                config BSP_SDRAM_ROW_BIT_13
                    bool "SDRAM SDRAM Row Bits 13-bits"
            endchoice

            choice BSP_SDRAM_CAS_LATENCY_SEL
                prompt "Select SDRAM CAS Latency"
                default BSP_SDRAM_CAS_LATENCY_3

                config BSP_SDRAM_CAS_LATENCY_1
                    bool "SDRAM SDRAM CAS Latency 1"

                config BSP_SDRAM_CAS_LATENCY_2
                    bool "SDRAM SDRAM CAS Latency 2"

                config BSP_SDRAM_CAS_LATENCY_3
                    bool "SDRAM SDRAM CAS Latency 3"
            endchoice

            config BSP_SDRAM_SIZE
                int "SDRAM Size (MBytes)"
                range 8 256
                default 32
        endif

endmenu

menu "On-chip Peripheral Drivers"

    config BSP_USING_GPIO
        bool "Enable GPIO"
        select RT_USING_PIN
        default y

    menuconfig BSP_USING_UART
        bool "Enable UART"
        default y
        select RT_USING_SERIAL
        if BSP_USING_UART
            config BSP_USING_UART1
                bool "Enable UART1"
                default y

            config BSP_UART1_RX_USING_DMA
                bool "Enable UART1 RX DMA"
                depends on BSP_USING_UART1 && RT_SERIAL_USING_DMA
                default n

            config BSP_UART1_TX_USING_DMA
                bool "Enable UART1 TX DMA"
                depends on BSP_USING_UART1 && RT_SERIAL_USING_DMA
                default n

            config BSP_USING_UART2
                bool "Enable UART2"
                default n

            config BSP_UART2_RX_USING_DMA
                bool "Enable UART2 RX DMA"
                depends on BSP_USING_UART2 && RT_SERIAL_USING_DMA
                default n

            config BSP_UART2_TX_USING_DMA
                bool "Enable UART2 TX DMA"
                depends on BSP_USING_UART2 && RT_SERIAL_USING_DMA
                default n

            config BSP_USING_UART3
                bool "Enable UART3"
                default n

            config BSP_UART3_RX_USING_DMA
                bool "Enable UART3 RX DMA"
                depends on BSP_USING_UART3 && RT_SERIAL_USING_DMA
                default n

            config BSP_UART3_TX_USING_DMA
                bool "Enable UART3 TX DMA"
                depends on BSP_USING_UART3 && RT_SERIAL_USING_DMA
                default n

            config BSP_USING_UART4
                bool "Enable UART4"
                default n

            config BSP_UART4_RX_USING_DMA
                bool "Enable UART4 RX DMA"
                depends on BSP_USING_UART4 && RT_SERIAL_USING_DMA
                default n

            config BSP_UART4_TX_USING_DMA
                bool "Enable UART4 TX DMA"
                depends on BSP_USING_UART4 && RT_SERIAL_USING_DMA
                default n

            config BSP_USING_UART5
                bool "Enable UART5"
                default n

            config BSP_UART5_RX_USING_DMA
                bool "Enable UART5 RX DMA"
                depends on BSP_USING_UART5 && RT_SERIAL_USING_DMA
                default n

            config BSP_UART5_TX_USING_DMA
                bool "Enable UART5 TX DMA"
                depends on BSP_USING_UART5 && RT_SERIAL_USING_DMA
                default n

            config BSP_USING_UART6
                bool "Enable UART6"
                default n

            config BSP_UART6_RX_USING_DMA
                bool "Enable UART6 RX DMA"
                depends on BSP_USING_UART6 && RT_SERIAL_USING_DMA
                default n

            config BSP_UART6_TX_USING_DMA
                bool "Enable UART6 TX DMA"
                depends on BSP_USING_UART6 && RT_SERIAL_USING_DMA
                default n

            config BSP_USING_UART7
                bool "Enable UART7"
                default n

            config BSP_UART7_RX_USING_DMA
                bool "Enable UART7 RX DMA"
                depends on BSP_USING_UART7 && RT_SERIAL_USING_DMA
                default n

            config BSP_UART7_TX_USING_DMA
                bool "Enable UART7 TX DMA"
                depends on BSP_USING_UART7 && RT_SERIAL_USING_DMA
                default n

            config BSP_USING_UART8
                bool "Enable UART8"
                default n

            config BSP_UART8_RX_USING_DMA
                bool "Enable UART8 RX DMA"
                depends on BSP_USING_UART8 && RT_SERIAL_USING_DMA
                default n

            config BSP_UART8_TX_USING_DMA
                bool "Enable UART8 TX DMA"
                depends on BSP_USING_UART8 && RT_SERIAL_USING_DMA
                default n

            config BSP_USING_UART9
                bool "Enable UART9"
                default n

            config BSP_UART9_RX_USING_DMA
                bool "Enable UART9 RX DMA"
                depends on BSP_USING_UART9 && RT_SERIAL_USING_DMA
                default n

            config BSP_UART9_TX_USING_DMA
                bool "Enable UART9 TX DMA"
                depends on BSP_USING_UART9 && RT_SERIAL_USING_DMA
                default n

            config BSP_USING_UART10
                bool "Enable UART10"
                default n

            config BSP_UART10_RX_USING_DMA
                bool "Enable UART10 RX DMA"
                depends on BSP_USING_UART10 && RT_SERIAL_USING_DMA
                default n

            config BSP_UART10_TX_USING_DMA
                bool "Enable UART10 TX DMA"
                depends on BSP_USING_UART10 && RT_SERIAL_USING_DMA
                default n

        endif

    config BSP_USING_ON_CHIP_FLASH
        bool "Enable on-chip FLASH"
        default n

    menuconfig BSP_USING_ONCHIP_RTC
        bool "Enable RTC"
        select RT_USING_RTC
        default n
        if BSP_USING_ONCHIP_RTC
            choice BSP_RTC_LS_SEL
                prompt "Select clock source"
                default BSP_RTC_USING_LSE

                config BSP_RTC_USING_LSE
                    bool "RTC USING LSE"

                config BSP_RTC_USING_LSI
                    bool "RTC USING LSI"
            endchoice
        endif

    config BSP_USING_WDT
        bool "Enable Watchdog Timer"
        select RT_USING_WDT
        default n

    menuconfig BSP_USING_FDCAN
        bool "Enable FDCAN (CAN FD)"
        default n
        select RT_USING_CAN
        select RT_CAN_USING_CANFD
        select RT_CAN_USING_HDR
        if BSP_USING_FDCAN
            config BSP_FDCAN_MSG_RAM_WORDS
                int "Shared Message RAM size (32-bit words)"
                range 1 4480
                default 768
                help
                    One continuous Message RAM array shared by FDCAN1/2/3.
                    Enabled instances are packed in instance order using
                    each instance's configured resource requirement.

            config BSP_USING_FDCAN1
                bool "Enable FDCAN1"
                default n
                if BSP_USING_FDCAN1
                    menu "FDCAN1 resource configuration"
                        config BSP_FDCAN1_USING_TDC
                            bool "Enable transmitter delay compensation"
                            default n

                        if BSP_FDCAN1_USING_TDC
                            config BSP_FDCAN1_TDC_OFFSET
                                int "TDC offset"
                                range 0 127
                                default 0

                            config BSP_FDCAN1_TDC_FILTER
                                int "TDC filter window"
                                range 0 127
                                default 0
                        endif

                        config BSP_FDCAN1_STD_FILTER_SIZE
                            int "Standard ID filter elements"
                            range 0 128
                            default 2

                        config BSP_FDCAN1_EXT_FILTER_SIZE
                            int "Extended ID filter elements"
                            range 0 64
                            default 2

                        config BSP_FDCAN1_RX_FIFO0_SIZE
                            int "RX FIFO0 elements"
                            range 1 64
                            default 8

                        config BSP_FDCAN1_RX_FIFO0_DATA_BYTES
                            int "RX FIFO0 data bytes per element"
                            range 8 64
                            default 64
                            help
                                Valid values: 8, 12, 16, 20, 24, 32, 48 or 64.

                        config BSP_FDCAN1_RX_FIFO1_SIZE
                            int "RX FIFO1 elements"
                            range 0 64
                            default 0

                        config BSP_FDCAN1_RX_FIFO1_DATA_BYTES
                            int "RX FIFO1 data bytes per element"
                            range 8 64
                            default 64
                            help
                                Valid values: 8, 12, 16, 20, 24, 32, 48 or 64.

                        config BSP_FDCAN1_RX_BUFFER_SIZE
                            int "Dedicated RX buffer elements"
                            range 0 64
                            default 0

                        config BSP_FDCAN1_RX_BUFFER_DATA_BYTES
                            int "Dedicated RX buffer data bytes per element"
                            range 8 64
                            default 64
                            help
                                Valid values: 8, 12, 16, 20, 24, 32, 48 or 64.

                        config BSP_FDCAN1_TX_EVENT_FIFO_SIZE
                            int "TX event FIFO elements"
                            range 0 32
                            default 0

                        config BSP_FDCAN1_TX_BUFFER_SIZE
                            int "Dedicated TX buffer elements"
                            range 1 32
                            default 3

                        config BSP_FDCAN1_TX_BUFFER_DATA_BYTES
                            int "TX buffer/FIFO data bytes per element"
                            range 8 64
                            default 64
                            help
                                Valid values: 8, 12, 16, 20, 24, 32, 48 or 64.

                        config BSP_FDCAN1_TX_QUEUE_MODE
                            bool "Use TX Queue mode (otherwise FIFO mode)"
                            default n

                        config BSP_FDCAN1_TX_FIFO_QUEUE_SIZE
                            int "TX FIFO/Queue elements"
                            range 0 31
                            default 0
                    endmenu
                endif

            config BSP_USING_FDCAN2
                bool "Enable FDCAN2"
                default n
                if BSP_USING_FDCAN2
                    menu "FDCAN2 resource configuration"
                        config BSP_FDCAN2_USING_TDC
                            bool "Enable transmitter delay compensation"
                            default n

                        if BSP_FDCAN2_USING_TDC
                            config BSP_FDCAN2_TDC_OFFSET
                                int "TDC offset"
                                range 0 127
                                default 0

                            config BSP_FDCAN2_TDC_FILTER
                                int "TDC filter window"
                                range 0 127
                                default 0
                        endif

                        config BSP_FDCAN2_STD_FILTER_SIZE
                            int "Standard ID filter elements"
                            range 0 128
                            default 2

                        config BSP_FDCAN2_EXT_FILTER_SIZE
                            int "Extended ID filter elements"
                            range 0 64
                            default 2

                        config BSP_FDCAN2_RX_FIFO0_SIZE
                            int "RX FIFO0 elements"
                            range 1 64
                            default 8

                        config BSP_FDCAN2_RX_FIFO0_DATA_BYTES
                            int "RX FIFO0 data bytes per element"
                            range 8 64
                            default 64
                            help
                                Valid values: 8, 12, 16, 20, 24, 32, 48 or 64.

                        config BSP_FDCAN2_RX_FIFO1_SIZE
                            int "RX FIFO1 elements"
                            range 0 64
                            default 0

                        config BSP_FDCAN2_RX_FIFO1_DATA_BYTES
                            int "RX FIFO1 data bytes per element"
                            range 8 64
                            default 64
                            help
                                Valid values: 8, 12, 16, 20, 24, 32, 48 or 64.

                        config BSP_FDCAN2_RX_BUFFER_SIZE
                            int "Dedicated RX buffer elements"
                            range 0 64
                            default 0

                        config BSP_FDCAN2_RX_BUFFER_DATA_BYTES
                            int "Dedicated RX buffer data bytes per element"
                            range 8 64
                            default 64
                            help
                                Valid values: 8, 12, 16, 20, 24, 32, 48 or 64.

                        config BSP_FDCAN2_TX_EVENT_FIFO_SIZE
                            int "TX event FIFO elements"
                            range 0 32
                            default 0

                        config BSP_FDCAN2_TX_BUFFER_SIZE
                            int "Dedicated TX buffer elements"
                            range 1 32
                            default 3

                        config BSP_FDCAN2_TX_BUFFER_DATA_BYTES
                            int "TX buffer/FIFO data bytes per element"
                            range 8 64
                            default 64
                            help
                                Valid values: 8, 12, 16, 20, 24, 32, 48 or 64.

                        config BSP_FDCAN2_TX_QUEUE_MODE
                            bool "Use TX Queue mode (otherwise FIFO mode)"
                            default n

                        config BSP_FDCAN2_TX_FIFO_QUEUE_SIZE
                            int "TX FIFO/Queue elements"
                            range 0 31
                            default 0
                    endmenu
                endif

            config BSP_USING_FDCAN3
                bool "Enable FDCAN3"
                default n
                if BSP_USING_FDCAN3
                    menu "FDCAN3 resource configuration"
                        config BSP_FDCAN3_USING_TDC
                            bool "Enable transmitter delay compensation"
                            default n

                        if BSP_FDCAN3_USING_TDC
                            config BSP_FDCAN3_TDC_OFFSET
                                int "TDC offset"
                                range 0 127
                                default 0

                            config BSP_FDCAN3_TDC_FILTER
                                int "TDC filter window"
                                range 0 127
                                default 0
                        endif

                        config BSP_FDCAN3_STD_FILTER_SIZE
                            int "Standard ID filter elements"
                            range 0 128
                            default 2

                        config BSP_FDCAN3_EXT_FILTER_SIZE
                            int "Extended ID filter elements"
                            range 0 64
                            default 2

                        config BSP_FDCAN3_RX_FIFO0_SIZE
                            int "RX FIFO0 elements"
                            range 1 64
                            default 8

                        config BSP_FDCAN3_RX_FIFO0_DATA_BYTES
                            int "RX FIFO0 data bytes per element"
                            range 8 64
                            default 64
                            help
                                Valid values: 8, 12, 16, 20, 24, 32, 48 or 64.

                        config BSP_FDCAN3_RX_FIFO1_SIZE
                            int "RX FIFO1 elements"
                            range 0 64
                            default 0

                        config BSP_FDCAN3_RX_FIFO1_DATA_BYTES
                            int "RX FIFO1 data bytes per element"
                            range 8 64
                            default 64
                            help
                                Valid values: 8, 12, 16, 20, 24, 32, 48 or 64.

                        config BSP_FDCAN3_RX_BUFFER_SIZE
                            int "Dedicated RX buffer elements"
                            range 0 64
                            default 0

                        config BSP_FDCAN3_RX_BUFFER_DATA_BYTES
                            int "Dedicated RX buffer data bytes per element"
                            range 8 64
                            default 64
                            help
                                Valid values: 8, 12, 16, 20, 24, 32, 48 or 64.

                        config BSP_FDCAN3_TX_EVENT_FIFO_SIZE
                            int "TX event FIFO elements"
                            range 0 32
                            default 0

                        config BSP_FDCAN3_TX_BUFFER_SIZE
                            int "Dedicated TX buffer elements"
                            range 1 32
                            default 3

                        config BSP_FDCAN3_TX_BUFFER_DATA_BYTES
                            int "TX buffer/FIFO data bytes per element"
                            range 8 64
                            default 64
                            help
                                Valid values: 8, 12, 16, 20, 24, 32, 48 or 64.

                        config BSP_FDCAN3_TX_QUEUE_MODE
                            bool "Use TX Queue mode (otherwise FIFO mode)"
                            default n

                        config BSP_FDCAN3_TX_FIFO_QUEUE_SIZE
                            int "TX FIFO/Queue elements"
                            range 0 31
                            default 0
                    endmenu
                endif
        endif

    source "$BSP_DIR/../libraries/N32_Drivers/drivers/Kconfig"

endmenu

menu "Board extended module Drivers"

endmenu

endmenu
```
